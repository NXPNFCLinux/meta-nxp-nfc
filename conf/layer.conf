## conf/layer.conf
```bitbake
# We have a conf and classes directory, add to BBPATH
BBPATH .= ":${LAYERDIR}"

# We have a packages directory, add to BBFILES
BBFILES += "${LAYERDIR}/recipes-*/*/*.bb \
            ${LAYERDIR}/recipes-*/*/*.bbappend"

BBFILE_COLLECTIONS += "nxp-nfc"
BBFILE_PATTERN_nxp-nfc := "^${LAYERDIR}/"
BBFILE_PRIORITY_nxp-nfc = "6"

LAYERDEPENDS_nxp-nfc = "core"
```
